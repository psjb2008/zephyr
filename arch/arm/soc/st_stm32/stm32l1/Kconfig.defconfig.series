## arch/arm/soc/st_stm32/stm32l1/Kconfig.defconfig.series
```kconfig
# Kconfig - ST Microelectronics STM32L1 MCU line
#
# Copyright (c) 2016 Open-RnD Sp. z o.o.
#
# SPDX-License-Identifier: Apache-2.0
#

if SOC_SERIES_STM32L1X

source "arch/arm/soc/st_stm32/stm32l1/Kconfig.defconfig.stm32l1*"

config SOC_SERIES
	default "stm32l1"

if GPIO_STM32

config GPIO_STM32_PORTD
	default y

endif # GPIO_STM32

endif # SOC_SERIES_STM32L1X
```

## arch/arm/soc/st_stm32/stm32l1/Kconfig.defconfig.stm32l152xx
```kconfig
# Kconfig - ST Microelectronics STM32L152XX MCU
#
# Copyright (c) 2017, embedjournal.com
#
# SPDX-License-Identifier: Apache-2.0
#

if SOC_STM32L152XD

config SOC
	string
	default "stm32l152xd"

config NUM_IRQS
	int
	default 57

if GPIO_STM32

config GPIO_STM32_PORTE
	default y

endif # GPIO_STM32

endif # SOC_STM32L152XD
```

## arch/arm/soc/st_stm32/stm32l1/Kconfig.soc
```kconfig
# Kconfig - ST Microelectronics STM32L1 MCU line
#
# Copyright (c) 2016 Open-RnD Sp. z o.o.
# Copyright (c) RnDity Sp. z o.o.
#
# SPDX-License-Identifier: Apache-2.0
#

choice
prompt "STM32L1x MCU Selection"
depends on SOC_SERIES_STM32L1X

config SOC_STM32L152XE
	bool "STM32L152XE"
	select SOC_STM32L152_DENSITY_DEVICE

config SOC_STM32L152XD
	bool "STM32L152XD"
	select SOC_STM32L152_DENSITY_DEVICE

endchoice

config SOC_STM32L152_DENSITY_DEVICE
	bool
	help
	 * Low density Value line devices
	 * Medium density Value line devices
	 * High density Value line devices
	 * XL-density devices Value line devices

config SOC_STM32L152_CONNECTIVITY_LINE_DEVICE
	bool
	help
	 Connectivity line devices are STM32L152xx
	 microcontrollers.  They are intended for applications where
	 connectivity and real-time performances are required such as
	 industrial control, control panels for security applications, UPS or
	 home audio.  
```

## boards/arm/nucleo_l152rd/Kconfig.board
```kconfig
# Kconfig - NUCLEO-64 L152RD board configuration
#
# Copyright (c) 2016 Open-RnD Sp. z o.o.
#
# SPDX-License-Identifier: Apache-2.0
#

config BOARD_NUCLEO_L152RD
	bool "NUCLEO-64 L152RD Development Board"
	depends on SOC_STM32L152XD
```

## boards/arm/nucleo_l152rd/Kconfig.defconfig
```kconfig
# Kconfig - NUCLEO-64 L152RD board configuration
#
# Copyright (c) 2016 Open-RnD Sp. z o.o.
#
# SPDX-License-Identifier: Apache-2.0
#

if BOARD_NUCLEO_L152RD

config BOARD
	default "nucleo_l152rd"

if UART_CONSOLE

config UART_STM32_PORT_2
	default y

endif # UART_CONSOLE

if SPI

config SPI_1
	default y

config SPI_2
	default y

endif

endif # BOARD_NUCLEO_L152RD
```

## boards/arm/nucleo_l152rd/nucleo_l152rd_defconfig
```kconfig
CONFIG_ARM=y
CONFIG_BOARD_NUCLEO_L152RD=y
CONFIG_SOC_SERIES_STM32L1X=y
CONFIG_SOC_STM32L152XD=y
CONFIG_CORTEX_M_SYSTICK=y
# 32MHz system clock
CONFIG_SYS_CLOCK_HW_CYCLES_PER_SEC=32000000
CONFIG_SYS_CLOCK_TICKS_PER_SEC=1000

# enable uart driver
CONFIG_SERIAL=y
# enable console
CONFIG_CONSOLE=y
CONFIG_UART_CONSOLE=y
CONFIG_UART_INTERRUPT_DRIVEN=y


# enable pinmux
CONFIG_PINMUX=y

# enable GPIO
CONFIG_GPIO=y

# clock configuration
CONFIG_CLOCK_CONTROL=y

# SYSCLK selection
CONFIG_CLOCK_STM32_SYSCLK_SRC_PLL=y

# use HSI as PLL input
CONFIG_CLOCK_STM32_PLL_SRC_HSI=y

# 
CONFIG_CLOCK_STM32_PLL_MULTIPLIER=6
CONFIG_CLOCK_STM32_PLL_DIVISOR=3
CONFIG_CLOCK_STM32_AHB_PRESCALER=1
CONFIG_CLOCK_STM32_APB1_PRESCALER=1
CONFIG_CLOCK_STM32_APB2_PRESCALER=1
```
